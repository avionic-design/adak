/**
 * Copyright (C) 2010 Avionic Design GmbH
 *
 * This program is free software; you can redistribute it and/or modify
 * it under the terms of the GNU General Public License version 2 as
 * published by the Free Software Foundation.
 */

SECTIONS {
	.data : {
		. = ALIGN(@COMMAND_ALIGN@);
		commands_start = .;
		*(.commands)
		commands_end = .;
	}
}
